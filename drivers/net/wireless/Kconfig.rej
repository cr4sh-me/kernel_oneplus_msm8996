## drivers/net/wireless/Kconfig.rej
```kconfig
--- drivers/net/wireless/Kconfig
+++ drivers/net/wireless/Kconfig
@@ -215,6 +215,7 @@ config USB_NET_RNDIS_WLAN
 	  If you choose to build a module, it'll be called rndis_wlan.
 
 source "drivers/net/wireless/rtl818x/Kconfig"
+source "drivers/net/wireless/rtl8xxxu/Kconfig"
 
 config ADM8211
 	tristate "ADMtek ADM8211 support"
```
